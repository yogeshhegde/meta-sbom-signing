## conf/layer.conf
```bitbake
# Layer configuration for meta-sbom-signing

BBPATH =. "${LAYERDIR}:"
BBFILES += "${LAYERDIR}/recipes-*/*/*.bb ${LAYERDIR}/recipes-*/*/*.bbappend"

BBFILE_COLLECTIONS += "sbom-signing"
BBFILE_PATTERN_sbom-signing = "^${LAYERDIR}/"
BBFILE_PRIORITY_sbom-signing = "10"

LAYERDEPENDS_sbom-signing = "core"
LAYERSERIES_COMPAT_sbom-signing = "wrynose"

# Default configuration
SBOM_SIGN_ENABLED ??= "0"
SBOM_SIGN_BACKEND ??= "cosign"
SBOM_SIGN_STRICT ??= "1"
```
